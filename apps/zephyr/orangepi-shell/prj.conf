## CMakeLists.txt
```
cmake_minimum_required(VERSION 3.20.0)

set(AKA_RK3588_SOURCE_DIR "" CACHE PATH "AKA checkout providing the Zephyr controller")
set(KCONFIG_ROOT "${CMAKE_CURRENT_SOURCE_DIR}/Kconfig")
if(AKA_RK3588_SOURCE_DIR)
  set(aka_app "${AKA_RK3588_SOURCE_DIR}/zephyr/orangepi_robot_control")
  if(NOT EXISTS "${aka_app}/CMakeLists.txt")
    message(FATAL_ERROR "AKA controller source not found: ${aka_app}")
  endif()
  set(KCONFIG_ROOT "${aka_app}/Kconfig")
  list(APPEND EXTRA_CONF_FILE "${aka_app}/prj.conf" "${CMAKE_CURRENT_SOURCE_DIR}/aka-shell.conf")
  set(DTC_OVERLAY_FILE "${aka_app}/app.overlay;${CMAKE_CURRENT_SOURCE_DIR}/boards/orangepi_5_plus_rk3588.overlay" CACHE STRING "Unified shell device tree overlays" FORCE)
else()
  set(DTC_OVERLAY_FILE "${CMAKE_CURRENT_SOURCE_DIR}/boards/orangepi_5_plus_rk3588.overlay" CACHE STRING "Unified shell device tree overlays" FORCE)
endif()
find_package(Zephyr REQUIRED HINTS $ENV{ZEPHYR_BASE})
project(orangepi_ivc_shell)

target_sources(app PRIVATE src/main.cpp src/axivc_tests.cpp src/ivc_benchmark.cpp src/aka_adapter.cpp src/irq_latency.cpp)
target_include_directories(app PRIVATE include)
include(${CMAKE_CURRENT_SOURCE_DIR}/arm-timer-observer.cmake)

set(AKA_RK3588_LIBRARY "" CACHE FILEPATH "Optional aka-rk3588 library")
set(AKA_RK3588_INCLUDE_DIR "" CACHE PATH "Optional aka-rk3588 include directory")
if(AKA_RK3588_SOURCE_DIR AND AKA_RK3588_LIBRARY)
  message(FATAL_ERROR "Select either AKA source or a prebuilt library")
endif()
if(AKA_RK3588_SOURCE_DIR)
  target_sources(app PRIVATE
    "${aka_app}/src/main.c"
    "${aka_app}/src/ivc_transport.c"
    "${aka_app}/src/robot_config_receiver.c"
    "${aka_app}/src/feetech_bus.c"
    "${aka_app}/src/robot_controller.c"
    "${aka_app}/src/resettable_watchdog.c")
  set_source_files_properties("${aka_app}/src/main.c" PROPERTIES
    COMPILE_DEFINITIONS main=aka_rk3588_run)
  target_include_directories(app PRIVATE "${AKA_RK3588_SOURCE_DIR}/protocol")
  target_compile_definitions(app PRIVATE TGOS_AKA_RK3588=1)
endif()
if(AKA_RK3588_LIBRARY)
  if(NOT EXISTS "${AKA_RK3588_LIBRARY}")
    message(FATAL_ERROR "AKA library does not exist: ${AKA_RK3588_LIBRARY}")
  endif()
  add_library(aka_rk3588_external UNKNOWN IMPORTED GLOBAL)
  set_target_properties(aka_rk3588_external PROPERTIES IMPORTED_LOCATION "${AKA_RK3588_LIBRARY}")
  target_link_libraries(app PRIVATE aka_rk3588_external)
  target_compile_definitions(app PRIVATE TGOS_AKA_RK3588=1)
endif()
if(AKA_RK3588_INCLUDE_DIR)
  target_include_directories(app PRIVATE "${AKA_RK3588_INCLUDE_DIR}")
endif()
```

## Kconfig
```
mainmenu "Orange Pi unified shell"

source "Kconfig.zephyr"
```

## sample.yaml
```
sample:
  description: Orange Pi AXIVC shell with selectable IVC workloads
  name: orangepi-ivc-shell
  tests:
    sample.orangepi.ivc.shell:
      platform_allow:
        - orangepi_5_plus_rk3588
```

## prj.conf
```kconfig
CONFIG_AXIVC=y
CONFIG_AXIVC_FALLBACK_POLL_MS=100
# Keep Zephyr's runtime physical-map window away from the image linked at
# 0x50000000. AXIVC maps the guest shared-memory GPA into this window.
CONFIG_KERNEL_VM_BASE=0x40000000
CONFIG_KERNEL_VM_SIZE=0x08000000
CONFIG_CPP=y
CONFIG_MAIN_STACK_SIZE=8192
CONFIG_SYSTEM_WORKQUEUE_STACK_SIZE=4096
CONFIG_PRINTK=y
CONFIG_SHELL=y
CONFIG_SHELL_BACKEND_SERIAL=y
CONFIG_SHELL_BACKEND_SERIAL_INTERRUPT_DRIVEN=n
CONFIG_SHELL_BACKEND_SERIAL_API_POLLING=y
CONFIG_UART_CONSOLE=y
CONFIG_CONSOLE=y
CONFIG_SERIAL=y
CONFIG_THREAD_STACK_INFO=y
# Allow Ctrl+C during shell_readline while a workload is active.
CONFIG_SHELL_METAKEYS=y
CONFIG_SHELL_PROMPT_UART="zephyr:~$ "

# Built-in inspection commands shared by IVC and AKA shell builds.
CONFIG_KERNEL_SHELL=y
CONFIG_DEVICE_SHELL=y
CONFIG_THREAD_MONITOR=y
CONFIG_THREAD_NAME=y
CONFIG_INIT_STACKS=y
```

## aka-shell.conf
```kconfig
# Preserve the unified shell and its IVC test capacity while linking AKA.
CONFIG_AXIVC_MAX_CHANNELS=4
# Allow Ctrl+C during shell_readline while a workload is active.
CONFIG_SHELL_METAKEYS=y
CONFIG_SHELL_PROMPT_UART="zephyr:~$ "
```

## boards/orangepi_5_plus_rk3588.overlay
```dts
&sram0 {
    reg = <0x40000000 0x08000000>;
};
```

## src/main.cpp
```c
#include "axivc_tests.h"
#include "aka_adapter.h"

#include <errno.h>
#include <stdlib.h>
#include <string.h>
#include <zephyr/sys/atomic.h>

#include <zephyr/kernel.h>
#include <zephyr/shell/shell.h>

namespace {

enum class job_state : unsigned char { idle, running, passed, failed, canceled };
job_state state = job_state::idle;
ivc_test active = ivc_test::latency;
int result = 0;
int active_timeout_ms = 30000;
atomic_t stop_requested = ATOMIC_INIT(0);
K_MUTEX_DEFINE(state_lock);
K_SEM_DEFINE(job_sem, 0, 1);
K_SEM_DEFINE(done_sem, 0, 1);
K_THREAD_STACK_DEFINE(job_stack, 16384);
k_thread job_thread;

const char *state_name(job_state value)
{
	switch (value) {
	case job_state::idle: return "idle";
	case job_state::running: return "running";
	case job_state::passed: return "passed";
	case job_state::failed: return "failed";
	case job_state::canceled: return "canceled";
	}
	return "unknown";
}

void worker(void *, void *, void *)
{
	while (true) {
		k_sem_take(&job_sem, K_FOREVER);
		k_mutex_lock(&state_lock, K_FOREVER);
		ivc_test test = active;
		int timeout_ms = active_timeout_ms;
		state = job_state::running;
		k_mutex_unlock(&state_lock);
		int rc = run_ivc_test(test, timeout_ms);
		k_mutex_lock(&state_lock, K_FOREVER);
		result = rc;
		/* Keep running until the waiting command consumes completion, so
		 * another shell cannot overwrite this job or steal its wakeup. */
		k_mutex_unlock(&state_lock);
		k_sem_give(&done_sem);
	}
}

int start_test(const struct shell *shell, ivc_test test, size_t argc, char **argv)
{
	int timeout_ms = 30000;
	if (argc == 2) {
		char *end;
		errno = 0;
		long parsed = strtol(argv[1], &end, 10);
		if (errno || !*argv[1] || *end || parsed < 1 || parsed > 600000) {
			shell_error(shell, "timeout_ms must be between 1 and 600000");
			return -EINVAL;
		}
		timeout_ms = static_cast<int>(parsed);
	}
	k_mutex_lock(&state_lock, K_FOREVER);
	if (state == job_state::running) {
		k_mutex_unlock(&state_lock);
		shell_error(shell, "test already running");
		return -EBUSY;
	}
	atomic_set(&stop_requested, 0);
	active = test;
	active_timeout_ms = timeout_ms;
	result = 0;
	state = job_state::running;
	k_mutex_unlock(&state_lock);
	const int64_t started_ms = k_uptime_get();
	/* The workload uses one deadline and unwinds normally on timeout.
	 * Wait for its cleanup instead of aborting a thread with live mappings. */
	shell_print(shell, "TEST_RUNNING timeout_ms=%d", timeout_ms);
	shell_print(shell, "Press Ctrl+C to stop.");
	k_sem_give(&job_sem);
	while (k_sem_take(&done_sem, K_NO_WAIT) != 0) {
		uint8_t input[32];
		int read = shell_readline(shell, input, sizeof(input), K_MSEC(20));
		if (read == -ECANCELED) {
			if (atomic_cas(&stop_requested, 0, 1))
				shell_print(shell, "stop requested");
		} else if (read > 0 && !strcmp(reinterpret_cast<char *>(input), "status")) {
			shell_print(shell, "state=running");
		}
	}
	k_mutex_lock(&state_lock, K_FOREVER);
	const int rc = result;
	state = rc == -ECANCELED ? job_state::canceled :
		rc == 0 ? job_state::passed : job_state::failed;
	const job_state finished = state;
	k_mutex_unlock(&state_lock);
	shell_print(shell, "elapsed_ms=%lld timeout_ms=%d",
		static_cast<long long>(k_uptime_get() - started_ms), timeout_ms);
	shell_print(shell, "state=%s result=%d", state_name(finished), rc);
	return rc;
}

int cmd_status(const struct shell *shell, size_t, char **)
{
	k_mutex_lock(&state_lock, K_FOREVER);
	const job_state current = state;
	const int rc = result;
	k_mutex_unlock(&state_lock);
	shell_print(shell, "state=%s result=%d", state_name(current), rc);
	return 0;
}

int cmd_aka_run(const struct shell *shell, size_t, char **)
{
	int rc = aka_adapter_run();
	shell_print(shell, "aka_run=%d", rc);
	return rc;
}

#define TEST_CMD(name, value) \
int cmd_##name(const struct shell *shell, size_t argc, char **argv) { return start_test(shell, ivc_test::value, argc, argv); }
TEST_CMD(latency, latency)
TEST_CMD(irq_latency, irq_latency)
TEST_CMD(publisher, publisher)
TEST_CMD(subscriber, subscriber)
TEST_CMD(pingpong, pingpong)
TEST_CMD(ivc_demo, demo)
TEST_CMD(ivc_benchmark, benchmark)

SHELL_STATIC_SUBCMD_SET_CREATE(ivc_commands,
	SHELL_CMD_ARG(latency, NULL, "run latency workload [timeout_ms]", cmd_latency, 1, 1),
	SHELL_CMD_ARG(publisher, NULL, "run Linux publisher peer test [timeout_ms]", cmd_publisher, 1, 1),
	SHELL_CMD_ARG(subscriber, NULL, "run Linux subscriber peer test [timeout_ms]", cmd_subscriber, 1, 1),
	SHELL_CMD_ARG(pingpong, NULL, "run ping-pong test [timeout_ms]", cmd_pingpong, 1, 1),
	SHELL_CMD_ARG(ivc_demo, NULL, "run StarryOS IVC demo [timeout_ms]", cmd_ivc_demo, 1, 1),
	SHELL_CMD_ARG(ivc_benchmark, NULL, "run StarryOS IVC benchmark [timeout_ms]", cmd_ivc_benchmark, 1, 1),
	SHELL_SUBCMD_SET_END
);
SHELL_CMD_REGISTER(ivc, &ivc_commands, "Orange Pi AXIVC workloads", NULL);
SHELL_STATIC_SUBCMD_SET_CREATE(irq_commands,
	SHELL_CMD_ARG(latency, NULL, "measure ARM timer IRQ interval deviation [timeout_ms]", cmd_irq_latency, 1, 1),
	SHELL_SUBCMD_SET_END
);
SHELL_CMD_REGISTER(irq, &irq_commands, "Interrupt measurements", NULL);
int cmd_aka_status(const struct shell *shell, size_t, char **)
{
    shell_print(shell, "aka_state=%s result=%d", aka_adapter_state(),
        aka_adapter_result());
    return 0;
}

SHELL_STATIC_SUBCMD_SET_CREATE(aka_commands,
	SHELL_CMD_ARG(run, NULL, "start the AKA controller", cmd_aka_run, 1, 0),
	SHELL_CMD_ARG(status, NULL, "show AKA controller state", cmd_aka_status, 1, 0),
	SHELL_SUBCMD_SET_END
);
SHELL_CMD_REGISTER(aka, &aka_commands, "AKA RK3588 library workloads", NULL);
SHELL_CMD_REGISTER(status, NULL, "show workload state", cmd_status);

} // namespace

bool workload_stop_requested()
{
	return atomic_get(&stop_requested) != 0;
}

extern "C" int main(void)
{
	k_thread_create(&job_thread, job_stack, K_THREAD_STACK_SIZEOF(job_stack),
		worker, nullptr, nullptr, nullptr, 5, 0, K_NO_WAIT);
	printk("ORANGEPI_ZEPHYR_SHELL_READY\n");
	return 0;
}
```

## include/aka_adapter.h
```c
#pragma once

/*
 * Optional ABI supplied by aka-rk3588.  The shell remains buildable without
 * the external library; when linked, these weak hooks are resolved by AKA.
 */
int aka_adapter_run();

const char *aka_adapter_state();
int aka_adapter_result();
```

## include/axivc_tests.h
```c
#pragma once

#include <axivc/axivc.h>
#include <errno.h>
#include <zephyr/kernel.h>

inline int ivc_remaining_ms(int64_t deadline)
{
	const int64_t left = deadline - k_uptime_get();
	return left > 0 ? static_cast<int>(left) : 0;
}

bool workload_stop_requested();

inline int workload_abort_result(int64_t deadline)
{
	if (workload_stop_requested()) return -ECANCELED;
	return ivc_remaining_ms(deadline) ? 0 : -ETIMEDOUT;
}

inline int ivc_send_before(axivc_channel_t *channel, const void *bytes,
			   size_t length, int64_t deadline)
{
	for (;;) {
		int abort = workload_abort_result(deadline);
		if (abort) return abort;
		const int remaining = ivc_remaining_ms(deadline);
		int ret = axivc_send(channel, bytes, length, remaining < 50 ? remaining : 50);
		if (ret != -ETIMEDOUT) return ret;
	}
}

inline int ivc_recv_before(axivc_channel_t *channel, void *bytes, size_t capacity,
			   size_t *length, int64_t deadline)
{
	for (;;) {
		int abort = workload_abort_result(deadline);
		if (abort) return abort;
		const int remaining = ivc_remaining_ms(deadline);
		int ret = axivc_recv(channel, bytes, capacity, length, remaining < 50 ? remaining : 50);
		if (ret != -ETIMEDOUT) return ret;
	}
}

inline axivc_channel_t *ivc_subscribe_before(uint64_t publisher, uint64_t key,
					  int64_t deadline)
{
	while (!workload_abort_result(deadline)) {
		const int remaining = ivc_remaining_ms(deadline);
		axivc_channel_t *channel = axivc_subscribe(publisher, key,
			remaining < 50 ? remaining : 50);
		if (channel) return channel;
		k_sleep(K_MSEC(1));
	}
	return nullptr;
}

enum class ivc_test : unsigned char {
	latency,
	irq_latency,
	publisher,
	subscriber,
	pingpong,
	demo,
	benchmark,
};

int run_ivc_test(ivc_test test, int timeout_ms);
```

## src/aka_adapter.cpp
```c
#include "aka_adapter.h"
#include <errno.h>
#include <zephyr/kernel.h>
#include <zephyr/sys/atomic.h>

#if defined(TGOS_AKA_RK3588)
/* A strong reference also extracts the entry from a static library. */
extern "C" int aka_rk3588_run(void);
#else
extern "C" int aka_rk3588_run(void) __attribute__((weak));
#endif

namespace {
K_THREAD_STACK_DEFINE(aka_stack, 16384);
k_thread aka_thread;
atomic_t state = ATOMIC_INIT(0);
atomic_t result = ATOMIC_INIT(0);

void worker(void *, void *, void *)
{
    const int rc = aka_rk3588_run();
    atomic_set(&result, rc);
    atomic_set(&state, 2);
    printk("AKA_WORKLOAD_EXIT result=%d\n", rc);
}
}

int aka_adapter_run()
{
#if !defined(TGOS_AKA_RK3588)
    if (!aka_rk3588_run) {
        return -ENOSYS;
    }
#endif
    /* The controller owns timers and hardware; start it once per boot. */
    if (!atomic_cas(&state, 0, 1)) {
        return -EALREADY;
    }
    k_thread_create(&aka_thread, aka_stack, K_THREAD_STACK_SIZEOF(aka_stack),
        worker, nullptr, nullptr, nullptr, 5, 0, K_NO_WAIT);
    return 0;
}

const char *aka_adapter_state()
{
    const atomic_val_t value = atomic_get(&state);
    if (value == 0) return "idle";
    if (value == 1) return "running";
    return atomic_get(&result) == 0 ? "passed" : "failed";
}

int aka_adapter_result()
{
    return static_cast<int>(atomic_get(&result));
}
```

## src/axivc_tests.cpp
```c
#include "axivc_tests.h"

#include <axivc/axivc.h>
#include <axivc/benchmark_config.h>
#include <axivc/demo_config.h>

#include <errno.h>
#include <string.h>

#include <zephyr/kernel.h>
#include <zephyr/sys/printk.h>

extern int run_ivc_benchmark(int64_t deadline);
extern int run_irq_latency(int64_t deadline);

namespace {

int publisher(int64_t deadline)
{
	axivc_channel_t *channel = axivc_publish(AXIVC_DEMO_CHANNEL_KEY,
		AXIVC_DEMO_CHANNEL_SIZE);
	if (!channel) {
		printk("ORANGEPI_ZEPHYR_PUBLISHER_FAILED open\n");
		return -ENODEV;
	}
	int ret = 0;
	for (int seq = 1; seq <= AXIVC_DEMO_MESSAGE_COUNT; ++seq) {
		char message[AXIVC_SLOT_PAYLOAD_SIZE];
		char ack[AXIVC_SLOT_PAYLOAD_SIZE + 1];
		size_t len = 0;
		snprintk(message, sizeof(message), "hello-%d", seq);
		ret = ivc_send_before(channel, message, strlen(message), deadline);
		if (ret < 0) break;
		ret = ivc_recv_before(channel, ack, AXIVC_SLOT_PAYLOAD_SIZE, &len, deadline);
		if (ret < 0) break;
		ack[len] = '\0';
		printk("ivc publisher seq=%d ack=%s\n", seq, ack);
	}
	axivc_close(channel);
	printk("ORANGEPI_ZEPHYR_PUBLISHER_%s\n", ret == -ECANCELED ? "CANCELED" : ret < 0 ? "FAILED" : "PASSED");
	return ret;
}

int subscriber(int64_t deadline)
{
	axivc_channel_t *channel = ivc_subscribe_before(AXIVC_DEMO_PUBLISHER_VM_ID,
		AXIVC_DEMO_CHANNEL_KEY, deadline);
	if (!channel) {
		const int ret = workload_abort_result(deadline);
		printk("ORANGEPI_ZEPHYR_SUBSCRIBER_%s open\n",
			ret == -ECANCELED ? "CANCELED" : "FAILED");
		return ret;
	}
	int ret = 0;
	for (int seq = 1; seq <= AXIVC_DEMO_MESSAGE_COUNT; ++seq) {
		char message[AXIVC_SLOT_PAYLOAD_SIZE + 1];
		size_t len = 0;
		ret = ivc_recv_before(channel, message, AXIVC_SLOT_PAYLOAD_SIZE, &len, deadline);
		if (ret < 0) break;
		message[len] = '\0';
		printk("ivc subscriber seq=%d msg=%s\n", seq, message);
		char expected[AXIVC_SLOT_PAYLOAD_SIZE];
		char reply[AXIVC_SLOT_PAYLOAD_SIZE];
		snprintk(expected, sizeof(expected), "linux-to-zephyr-%d\n", seq);
		if (len != strlen(expected) || memcmp(message, expected, len)) {
			ret = -EPROTO;
			break;
		}
		snprintk(reply, sizeof(reply), "zephyr-to-linux-%d\n", seq);
		ret = ivc_send_before(channel, reply, strlen(reply), deadline);
		if (ret < 0) break;
	}
	/* Keep the subscriber mapping alive until the peer has finished its
	 * teardown. The next test run resets the VM/channel state. */
	printk("ORANGEPI_ZEPHYR_SUBSCRIBER_%s\n", ret == -ECANCELED ? "CANCELED" : ret < 0 ? "FAILED" : "PASSED");
	return ret;
}

int pingpong(int64_t deadline)
{
	axivc_channel_t *channel = axivc_publish(AXIVC_DEMO_CHANNEL_KEY,
		AXIVC_DEMO_CHANNEL_SIZE);
	if (!channel) {
		printk("ORANGEPI_ZEPHYR_PINGPONG_FAILED open\n");
		return -ENODEV;
	}
	int ret = 0;
	for (int seq = 1; seq <= AXIVC_DEMO_MESSAGE_COUNT; ++seq) {
		char ping[AXIVC_SLOT_PAYLOAD_SIZE];
		char pong[AXIVC_SLOT_PAYLOAD_SIZE + 1];
		size_t len = 0;
		snprintk(ping, sizeof(ping), "ping-%d", seq);
		ret = ivc_send_before(channel, ping, strlen(ping), deadline);
		if (ret < 0) break;
		ret = ivc_recv_before(channel, pong, AXIVC_SLOT_PAYLOAD_SIZE, &len, deadline);
		if (ret < 0) break;
		pong[len] = '\0';
		printk("ivc pingpong seq=%d pong=%s\n", seq, pong);
	}
	axivc_close(channel);
	printk("ORANGEPI_ZEPHYR_PINGPONG_%s\n", ret == -ECANCELED ? "CANCELED" : ret < 0 ? "FAILED" : "PASSED");
	return ret;
}

int starry_demo(int64_t deadline)
{
	axivc_channel_t *channel = axivc_publish(AXIVC_DEMO_CHANNEL_KEY,
		AXIVC_DEMO_CHANNEL_SIZE);
	if (!channel) {
		printk("ORANGEPI_ZEPHYR_IVC_DEMO_FAILED open\n");
		return -ENODEV;
	}
	printk("ORANGEPI_ZEPHYR_IVC_DEMO_WAITING\n");
	int ret = 0;
	/* Match the existing Starry demo's batch exchange. Each reply is still
	 * checked against its complete message and sequence number. */
	for (int seq = 1; seq <= AXIVC_DEMO_MESSAGE_COUNT; ++seq) {
		char message[AXIVC_SLOT_PAYLOAD_SIZE];
		snprintk(message, sizeof(message), "zephyr-to-starry-%d\n", seq);
		ret = ivc_send_before(channel, message, strlen(message), deadline);
		if (ret < 0) break;
		printk("ivc demo sent %d/%d\n", seq, AXIVC_DEMO_MESSAGE_COUNT);
	}
	for (int seq = 1; !ret && seq <= AXIVC_DEMO_MESSAGE_COUNT; ++seq) {
		char expected[AXIVC_SLOT_PAYLOAD_SIZE];
		char reply[AXIVC_SLOT_PAYLOAD_SIZE + 1];
		size_t len = 0;
		ret = ivc_recv_before(channel, reply, AXIVC_SLOT_PAYLOAD_SIZE, &len, deadline);
		if (ret < 0) break;
		snprintk(expected, sizeof(expected), "starry-to-zephyr-%d\n", seq);
		if (len != strlen(expected) || memcmp(reply, expected, len)) {
			ret = -EPROTO;
			break;
		}
		reply[len] = '\0';
		printk("starry reply %d/%d: %s\n", seq, AXIVC_DEMO_MESSAGE_COUNT, reply);
	}
	int close_ret = axivc_close(channel);
	if (!ret) ret = close_ret;
	if (ret < 0) printk("ORANGEPI_ZEPHYR_IVC_DEMO_RET=%d\n", ret);
	printk("ORANGEPI_ZEPHYR_IVC_DEMO_%s\n", ret == -ECANCELED ? "CANCELED" : ret < 0 ? "FAILED" : "PASSED");
	return ret;
}

int benchmark(int64_t deadline)
{
	int ret = run_ivc_benchmark(deadline);
	printk("ORANGEPI_ZEPHYR_IVC_BENCHMARK_%s\n", ret == -ECANCELED ? "CANCELED" : ret < 0 ? "FAILED" : "PASSED");
	return ret;
}

int latency(int64_t deadline)
{
	uint64_t start = k_cycle_get_64();
	for (unsigned int i = 0; i < 1000; ++i) {
		if (int abort = workload_abort_result(deadline)) return abort;
		k_yield();
	}
	uint64_t elapsed = k_cycle_get_64() - start;
	printk("latency yield_cycles=%llu\n", (unsigned long long)elapsed);
	printk("ORANGEPI_ZEPHYR_LATENCY_PASSED\n");
	return 0;
}

} // namespace

int run_ivc_test(ivc_test test, int timeout_ms)
{
	const int64_t deadline = k_uptime_get() + timeout_ms;
	switch (test) {
	case ivc_test::latency: return latency(deadline);
	case ivc_test::irq_latency: return run_irq_latency(deadline);
	case ivc_test::publisher: return publisher(deadline);
	case ivc_test::subscriber: return subscriber(deadline);
	case ivc_test::pingpong: return pingpong(deadline);
	case ivc_test::demo: return starry_demo(deadline);
	case ivc_test::benchmark: return benchmark(deadline);
	}
	return -EINVAL;
}
```

## src/irq_latency.cpp
```c
#include "axivc_tests.h"

#include <zephyr/sys/atomic.h>
#include <zephyr/sys/printk.h>

namespace {
constexpr uint32_t sample_target = 10000;
constexpr uint32_t warmup_target = 5;
static_assert(CONFIG_MP_MAX_NUM_CPUS == 1,
              "The ARM timer observer supports one guest vCPU");
struct distribution {
    uint64_t minimum = UINT64_MAX;
    uint64_t maximum = 0;
    uint64_t total = 0;
};
struct measurement {
    uint32_t samples = 0;
    uint32_t warmup = 0;
    uint32_t skipped = 0;
    uint32_t tick_cycles = 0;
    uint64_t previous_entry = 0;
    uint64_t previous_compare = 0;
    bool bad_context = false;
    distribution deadline_deviation;
    distribution interval_deviation;
};
k_spinlock measurement_lock;
atomic_t observing = ATOMIC_INIT(0);
measurement data;

void accumulate(distribution &stats, uint64_t cycles)
{
    stats.minimum = cycles < stats.minimum ? cycles : stats.minimum;
    stats.maximum = cycles > stats.maximum ? cycles : stats.maximum;
    stats.total += cycles;
}

uint64_t difference(uint64_t actual, uint64_t expected)
{
    return actual >= expected ? actual - expected : expected - actual;
}

void keep_timer_active(struct k_timer *) {}
// A 1 ms heartbeat keeps real timer IRQs flowing while retaining tickless mode.
K_TIMER_DEFINE(measurement_heartbeat, keep_timer_active, nullptr);

void print_distribution(const char *name, const distribution &stats, uint32_t count)
{
    const uint64_t average = stats.total / count;
    printk("%s samples=%u min_cycles=%llu avg_cycles=%llu max_cycles=%llu\n",
           name, count, static_cast<unsigned long long>(stats.minimum),
           static_cast<unsigned long long>(average),
           static_cast<unsigned long long>(stats.maximum));
    printk("%s min_ns=%llu avg_ns=%llu max_ns=%llu\n", name,
           static_cast<unsigned long long>(k_cyc_to_ns_floor64(stats.minimum)),
           static_cast<unsigned long long>(k_cyc_to_ns_floor64(average)),
           static_cast<unsigned long long>(k_cyc_to_ns_floor64(stats.maximum)));
}
}

extern "C" void orangepi_timer_irq_sample(uint64_t now, uint64_t tick_base,
                                           uint32_t tick_cycles, uint64_t compare)
{
    if (!atomic_get(&observing)) return;
    const k_spinlock_key_t key = k_spin_lock(&measurement_lock);
    if (!atomic_get(&observing)) {
        k_spin_unlock(&measurement_lock, key);
        return;
    }
    data.tick_cycles = tick_cycles;
    if (!k_is_in_isr()) {
        data.bad_context = true;
        atomic_set(&observing, 0);
    } else if (data.warmup++ < warmup_target || !tick_base ||
               !compare || compare == UINT64_MAX) {
        // Discard startup samples; remember the last actual timer event.
    } else if (now <= data.previous_entry || compare <= data.previous_compare ||
               now < tick_base || compare < tick_base) {
        ++data.skipped;
    } else {
        const uint64_t actual_tick_window = now - tick_base;
        const uint64_t programmed_tick_window = compare - tick_base;
        // With a periodic timer this is abs(now - last_cycle - CYC_PER_TICK),
        // matching the reference. Tickless uses the actual programmed window.
        accumulate(data.deadline_deviation,
                   difference(actual_tick_window, programmed_tick_window));
        accumulate(data.interval_deviation,
                   difference(now - data.previous_entry,
                              compare - data.previous_compare));
        if (++data.samples == sample_target) atomic_set(&observing, 0);
    }
    data.previous_entry = now;
    data.previous_compare = compare;
    k_spin_unlock(&measurement_lock, key);
}

int run_irq_latency(int64_t deadline)
{
    k_spinlock_key_t key = k_spin_lock(&measurement_lock);
    data = measurement{};
    atomic_set(&observing, 1);
    k_spin_unlock(&measurement_lock, key);
    printk("IRQ_LATENCY_BEGIN source=arch_timer samples=%u warmup=%u tickless=%d heartbeat_ms=1\n",
           sample_target, warmup_target, IS_ENABLED(CONFIG_TICKLESS_KERNEL));
    k_timer_start(&measurement_heartbeat, K_MSEC(1), K_MSEC(1));
    int ret = 0;
    measurement snapshot;
    for (;;) {
        key = k_spin_lock(&measurement_lock);
        snapshot = data;
        k_spin_unlock(&measurement_lock, key);
        if (snapshot.bad_context) {
            ret = -EIO;
            break;
        }
        if (snapshot.samples == sample_target) break;
        ret = workload_abort_result(deadline);
        if (ret) break;
        k_sleep(K_MSEC(5));
    }
    key = k_spin_lock(&measurement_lock);
    atomic_set(&observing, 0);
    snapshot = data;
    k_spin_unlock(&measurement_lock, key);
    // Never acquire the clock lock while holding measurement_lock. The ISR
    // takes clock -> measurement; timer operations run after releasing it.
    k_timer_stop(&measurement_heartbeat);
    if (snapshot.samples) {
        print_distribution("IRQ_LATENCY", snapshot.deadline_deviation, snapshot.samples);
        print_distribution("IRQ_INTERVAL_DEVIATION", snapshot.interval_deviation, snapshot.samples);
    }
    printk("IRQ_TIMER_STATS tick_cycles=%u skipped=%u\n", snapshot.tick_cycles, snapshot.skipped);
    if (ret) {
        printk("IRQ_LATENCY_%s result=%d samples=%u\n",
               ret == -ECANCELED ? "CANCELED" : "FAILED", ret, snapshot.samples);
        return ret;
    }
    printk("IRQ_LATENCY_PASSED\n");
    return 0;
}
```

## src/ivc_benchmark.cpp
```c
#include "axivc_tests.h"

#include <axivc/axivc.h>
#include <axivc/benchmark_config.h>
#include <axivc/zephyr_platform.h>

#include <errno.h>
#include <stddef.h>
#include <stdint.h>
#include <string.h>

#include <zephyr/kernel.h>

static_assert(
	sizeof(struct axivc_bench_message) == AXIVC_SLOT_PAYLOAD_SIZE,
	"AXIVC benchmark message must fit in one slot");

static uint8_t source_data[AXIVC_BENCH_MAX_DATA_SIZE];

static uint64_t now_us(void)
{
	return k_cyc_to_us_floor64(k_cycle_get_64());
}

static uint32_t load_u32(volatile uint8_t *base, uint32_t offset)
{
	return __atomic_load_n(
		(volatile uint32_t *)(base + offset), __ATOMIC_ACQUIRE);
}

static void store_u32(volatile uint8_t *base, uint32_t offset, uint32_t value)
{
	__atomic_store_n((volatile uint32_t *)(base + offset), value, __ATOMIC_RELEASE);
}

static int send_message(
	axivc_channel_t *channel, const struct axivc_bench_message *msg, int64_t deadline)
{
	return ivc_send_before(channel, msg, sizeof(*msg), deadline);
}

static int recv_ack(
	axivc_channel_t *channel, const struct axivc_bench_message *data, int64_t deadline)
{
	struct axivc_bench_message ack = {};
	size_t len = 0;
	int ret = ivc_recv_before(
		channel, &ack, sizeof(ack), &len, deadline);

	if (ret < 0)
		return ret;
	if (len != sizeof(ack) || ack.magic != AXIVC_BENCH_MAGIC ||
	    ack.type != AXIVC_BENCH_TYPE_ACK || ack.case_index != data->case_index ||
	    ack.iteration != data->iteration || ack.len != data->len ||
	    ack.value != data->value)
		return -EPROTO;
	return 0;
}

static int send_payload(
	axivc_channel_t *channel, volatile uint8_t *window, uint32_t case_index,
	uint32_t iteration, uint32_t size, uint64_t *bandwidth_x100_sum,
	uint64_t *copy_bandwidth_x100_sum, uint64_t *flush_bandwidth_x100_sum,
	int64_t deadline)
{
	uint8_t *payload = (uint8_t *)window + AXIVC_BENCH_SHMEM_PAYLOAD_OFFSET;
	struct axivc_bench_message msg = {};
	uint64_t start;
	uint64_t flush_start;
	uint64_t copy_elapsed_us;
	uint64_t flush_elapsed_us;
	uint64_t elapsed_us;

	axivc_cache_invalidate(
		channel, (const void *)window, AXIVC_BENCH_SHMEM_PAYLOAD_OFFSET);
	while (load_u32(window, AXIVC_BENCH_SHMEM_FLAG_OFFSET) !=
	       AXIVC_BENCH_SHMEM_INVALID)
	{
		if (int abort = workload_abort_result(deadline)) return abort;
		k_sleep(K_MSEC(1));
		axivc_cache_invalidate(
			channel, (const void *)window,
			AXIVC_BENCH_SHMEM_PAYLOAD_OFFSET);
	}

	start = now_us();
	memcpy(payload, source_data, size);
	store_u32(window, AXIVC_BENCH_SHMEM_LEN_OFFSET, size);
	store_u32(window, AXIVC_BENCH_SHMEM_FLAG_OFFSET, AXIVC_BENCH_SHMEM_VALID);
	flush_start = now_us();
	axivc_zephyr_platform_flush(
		(const void *)window, AXIVC_BENCH_SHMEM_PAYLOAD_OFFSET + size);
	elapsed_us = now_us() - start;
	copy_elapsed_us = flush_start - start;
	flush_elapsed_us = elapsed_us - copy_elapsed_us;
	*bandwidth_x100_sum += axivc_bench_bandwidth_centi_mib(elapsed_us, size);
	*copy_bandwidth_x100_sum +=
		axivc_bench_bandwidth_centi_mib(copy_elapsed_us, size);
	*flush_bandwidth_x100_sum +=
		axivc_bench_bandwidth_centi_mib(flush_elapsed_us, size);

	msg.magic = AXIVC_BENCH_MAGIC;
	msg.type = AXIVC_BENCH_TYPE_DATA;
	msg.case_index = case_index;
	msg.iteration = iteration;
	msg.offset = 0;
	msg.len = size;
	msg.total_size = size;
	msg.value = axivc_bench_checksum(source_data, size);

	int ret = send_message(channel, &msg, deadline);
	if (ret < 0)
		return ret;
	return recv_ack(channel, &msg, deadline);
}

static int send_stats(
	axivc_channel_t *channel, uint32_t case_index, uint32_t size,
	uint64_t average_bandwidth_x100, uint64_t average_copy_bandwidth_x100,
	uint64_t average_flush_bandwidth_x100, int64_t deadline)
{
	struct axivc_bench_message msg = {};

	msg.magic = AXIVC_BENCH_MAGIC;
	msg.type = AXIVC_BENCH_TYPE_STATS;
	msg.case_index = case_index;
	msg.offset = average_copy_bandwidth_x100;
	msg.reserved = (uint32_t)average_flush_bandwidth_x100;
	msg.total_size = size;
	msg.value = average_bandwidth_x100;
	return send_message(channel, &msg, deadline);
}

static int send_done(axivc_channel_t *channel, int64_t deadline)
{
	struct axivc_bench_message msg = {};

	msg.magic = AXIVC_BENCH_MAGIC;
	msg.type = AXIVC_BENCH_TYPE_DONE;
	return send_message(channel, &msg, deadline);
}

int run_ivc_benchmark(int64_t deadline)
{
	axivc_channel_t *channel =
		axivc_publish(AXIVC_BENCH_CHANNEL_KEY, AXIVC_BENCH_CHANNEL_SIZE);
	size_t region_size = 0;
	uint8_t *region;
	volatile uint8_t *window;
	uint32_t transfers = 0;
	size_t window_size;
	int ret = 0;

	if (!channel)
	{
		printk("AXIVC Zephyr-Starry benchmark publish failed\n");
		return -ENODEV;
	}

	region = (uint8_t *)axivc_shared_region(channel, &region_size);
	if (!region || region_size < AXIVC_BENCH_CHANNEL_SIZE)
	{
		printk("AXIVC Zephyr-Starry benchmark shared region unavailable\n");
		ret = -EINVAL;
		goto out;
	}

	window = region + sizeof(struct axivc_region);
	window_size = region_size - sizeof(struct axivc_region);
	store_u32(window, AXIVC_BENCH_SHMEM_FLAG_OFFSET, AXIVC_BENCH_SHMEM_INVALID);
	axivc_cache_flush(
		channel, (const void *)window, AXIVC_BENCH_SHMEM_PAYLOAD_OFFSET);
	axivc_bench_fill(source_data, sizeof(source_data));

	printk(
		"[test_output] IVC random block bench created, testTime = %u, "
		"windowSize = %u\n",
		AXIVC_BENCH_ITERATIONS, (unsigned int)window_size);

	for (uint32_t case_index = 0; case_index < AXIVC_BENCH_SIZE_COUNT;
	     case_index++)
	{
		uint32_t size = axivc_bench_size_at(case_index);
		uint64_t send_bandwidth_x100_sum = 0;
		uint64_t copy_bandwidth_x100_sum = 0;
		uint64_t flush_bandwidth_x100_sum = 0;

		for (uint32_t iteration = 0; iteration < AXIVC_BENCH_ITERATIONS;
		     iteration++)
		{
			ret = send_payload(
				channel, window, case_index, iteration, size,
				&send_bandwidth_x100_sum, &copy_bandwidth_x100_sum,
				&flush_bandwidth_x100_sum, deadline);
			if (ret < 0)
				goto out;
			transfers++;
		}
		uint64_t average_bandwidth_x100 =
			send_bandwidth_x100_sum / AXIVC_BENCH_ITERATIONS;
		uint64_t average_copy_bandwidth_x100 =
			copy_bandwidth_x100_sum / AXIVC_BENCH_ITERATIONS;
		uint64_t average_flush_bandwidth_x100 =
			flush_bandwidth_x100_sum / AXIVC_BENCH_ITERATIONS;
		printk("ivc bench publish case=%u datasize=%u\n", case_index, size);
		ret = send_stats(
			channel, case_index, size, average_bandwidth_x100,
			average_copy_bandwidth_x100, average_flush_bandwidth_x100, deadline);
		if (ret < 0)
			goto out;
	}

	ret = send_done(channel, deadline);
	(void)transfers;

out:
	if (ret < 0)
		printk("AXIVC Zephyr-Starry benchmark failed: %s\n", axivc_strerror(ret));
	axivc_close(channel);
	return ret;
}
```
