## CMakeLists.txt
```
cmake_minimum_required(VERSION 3.20.0)
find_package(Zephyr REQUIRED HINTS $ENV{ZEPHYR_BASE})
project(zephyr_triple_guest_functional)
target_sources(app PRIVATE src/main.c)
```

## prj.conf
```kconfig
# Zephyr guest image for the Orange Pi 5 Plus Linux + StarryOS + Zephyr
# three-guest functional test (`zephyr-triple-guest-functional`).
#
# The TGOSImages `orangepi-5-plus` target (`orangepi_5_plus_rk3588`) provides the
# NS16550 UART and the ARM arch timer; the guest pins the word-only UART access
# mode used by the virtual console.
CONFIG_ARM_ARCH_TIMER=y
CONFIG_ARM64_VA_BITS_40=y
CONFIG_ARM64_PA_BITS_40=y
CONFIG_SERIAL=y
CONFIG_UART_NS16550=y
CONFIG_UART_NS16550_ACCESS_WORD_ONLY=y
CONFIG_UART_INTERRUPT_DRIVEN=y
CONFIG_CONSOLE=y
CONFIG_UART_CONSOLE=y
CONFIG_ARMV8_A_NS=y
CONFIG_CACHE_MANAGEMENT=y

CONFIG_PRINTK=y
CONFIG_ASSERT=y
CONFIG_BUILD_OUTPUT_BIN=y
CONFIG_SMP=n
CONFIG_MAIN_STACK_SIZE=4096

# The three-guest functional checks match the prompt verbatim, so it must stay
# `zephyr:~$ `.
CONFIG_SHELL=y
CONFIG_SHELL_BACKEND_SERIAL=y
CONFIG_SHELL_PROMPT_UART="zephyr:~$ "
CONFIG_SHELL_STACK_SIZE=4096
CONFIG_KERNEL_SHELL=y
CONFIG_DEVICE_SHELL=y
CONFIG_THREAD_MONITOR=y
CONFIG_THREAD_NAME=y
CONFIG_INIT_STACKS=y
CONFIG_THREAD_STACK_INFO=y
```

## boards/orangepi_5_plus_rk3588.overlay
```dts
/* SPDX-License-Identifier: Apache-2.0 */
/*
 * Orange Pi 5 Plus Linux + StarryOS + Zephyr three-guest functional image
 * (`zephyr-triple-guest-functional`): pin the guest RAM window to the region the
 * VM configuration actually maps.
 *
 * The Zephyr client (VM3) is given
 * `memory_regions = [[0x4000_0000, 0x0800_0000, 0x7, 0]]` (128 MiB), while the
 * board devicetree declares `sram0` as `memory@40000000` with 1 GiB. Zephyr
 * derives its memory and heap layout from that node, so the compiled devicetree
 * has to describe the same 128 MiB the guest is allowed to touch; otherwise the
 * guest can place data outside its mapped RAM and stall without any CPU fault.
 *
 * The GIC is deliberately *not* overridden. VM3 is a fully virtualized guest
 * with no physical passthrough, and its VM configuration opts in to the
 * synthetic vGIC following the host firmware GIC addresses, so AxVisor serves
 * GICD 0xfe600000 (0x10000) and GICR 0xfe680000 (0x100000) - exactly what the
 * stock RK3588 devicetree already describes in `&gic`. Rewriting `&gic` here
 * would point the guest at the machine-fallback geometry (0x08000000) instead.
 *
 * The UART, the timer PPIs, the entry point and the single vCPU are untouched.
 *
 * Zephyr picks this file up automatically because it is the application overlay
 * named after the board: cmake/modules/configuration_files.cmake turns
 * `<app>/boards/<board>[_<soc>].overlay` into DTC_OVERLAY_FILE. This board has a
 * single SoC, so `orangepi_5_plus_rk3588.overlay` is the shortened name Zephyr
 * accepts; `orangepi_5_plus_rk3588_rk3588.overlay` is the equivalent long name,
 * and Zephyr would fail on conflicting overlay candidates if both existed.
 */
&sram0 {
	reg = <0x40000000 0x08000000>;	/* 0x0800_0000 = 128 MiB guest RAM */
};
```

## src/main.c
```c
/* SPDX-License-Identifier: Apache-2.0 */
/*
 * Minimal Zephyr guest application for the Orange Pi 5 Plus Linux + StarryOS +
 * Zephyr three-guest functional test image (`zephyr-triple-guest-functional`).
 *
 * It only brings up the serial shell so the board checks can use Zephyr's own
 * `kernel version`, `kernel thread list` and `device list` commands; it adds no
 * functional check of its own.
 */
#include <zephyr/kernel.h>

int main(void)
{
	printk("Zephyr triple-guest functional shell ready.\n");

	/* Zephyr keeps running after main() returns, so the shell stays usable. */
	return 0;
}
```
